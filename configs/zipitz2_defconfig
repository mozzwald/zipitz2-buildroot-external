## configs/zipitz2_defconfig
```kconfig
BR2_arm=y
BR2_iwmmxt=y
BR2_KERNEL_HEADERS_VERSION=y
BR2_DEFAULT_KERNEL_VERSION="3.17.1"
BR2_PACKAGE_HOST_LINUX_HEADERS_CUSTOM_3_17=y
BR2_TOOLCHAIN_BUILDROOT_WCHAR=y
BR2_TOOLCHAIN_BUILDROOT_CXX=y
BR2_LINUX_KERNEL=y
BR2_LINUX_KERNEL_CUSTOM_GIT=y
BR2_LINUX_KERNEL_CUSTOM_REPO_URL="https://github.com/anarsoul/linux-2.6"
BR2_LINUX_KERNEL_CUSTOM_REPO_VERSION="v3.17-anarsoul-wip"
BR2_LINUX_KERNEL_USE_CUSTOM_CONFIG=y
BR2_LINUX_KERNEL_CUSTOM_CONFIG_FILE="$(BR2_EXTERNAL)/board/zipitz2/linux-3.17_jffs.config"
BR2_PACKAGE_BUSYBOX_CONFIG="$(BR2_EXTERNAL)/board/zipitz2/busybox_jffs.config"
BR2_PACKAGE_WIRELESS_TOOLS=y
BR2_PACKAGE_WIRELESS_TOOLS_LIB=y
BR2_PACKAGE_WPA_SUPPLICANT=y
BR2_PACKAGE_WPA_SUPPLICANT_CLI=y
BR2_PACKAGE_WPA_SUPPLICANT_PASSPHRASE=y
BR2_TARGET_ROOTFS_JFFS2=y
BR2_TARGET_ROOTFS_JFFS2_FLASH_64=y
BR2_TARGET_ROOTFS_TAR_BZIP2=y
BR2_DEFCONFIG="$(BR2_EXTERNAL)/configs/zipitz2_defconfig"
```

## package/Config.in
```kconfig
menu "Zipit Z2 Specific"
	source "$BR2_EXTERNAL/package/bldaemon-zipit/Config.in"
endmenu

source "$BR2_EXTERNAL/package/htpdate/Config.in"
```

## package/bldaemon-zipit/Config.in
```kconfig
config BR2_PACKAGE_BLDAEMON_ZIPIT
	bool "bldaemon-zipit"
	help
	  bldaemon-zipit: Automatic backlight controls for Zipit Z2

	  https://github.com/engine12/bldaemon-zipit
```

## package/htpdate/Config.in
```kconfig
config BR2_PACKAGE_HTPDATE
    bool "htpdate"
	help
	  htpdate uses http to syncronize a computer's time.

	  http://www.vervest.org/htp/
```
